## config/west.yml
```yaml
manifest:
  remotes:
    - name: zmkfirmware
      url-base: https://github.com/zmkfirmware
    - name: Radirwolf
      url-base: https://github.com/Radirwolf
  projects:
    - name: zmk
      remote: zmkfirmware
      revision: main
      import: app/west.yml
    - name: zmk-config-totem
      remote: Radirwolf
      revision: main
  self:
    path: config
```
